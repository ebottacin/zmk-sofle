        ctrl_a_combo {
            timeout-ms    = <COMBO_TIMEOUT_BASE>;
            key-positions = <27 15>;
            layers        = <0 1 2 3>;
            bindings      = <&kp LC(A)>;
        };

        bkspc_combo {
            timeout-ms    = <COMBO_TIMEOUT_BASE>;
            key-positions = <1 2>;
            layers        = <0 1 2 3>;
            bindings      = <&kp BACKSPACE>;
        };

        del_combo {
            timeout-ms    = <COMBO_TIMEOUT_BASE>;
            key-positions = <14 15>;
            layers        = <0 1 2 3>;
            bindings      = <&kp DELETE>;
        };