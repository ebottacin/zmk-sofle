## config/west.yml
```yaml
manifest:
  defaults:
    revision: v0.3

  remotes:
    - name: zmkfirmware
      url-base: https://github.com/zmkfirmware
    - name: cormoran
      url-base: https://github.com/cormoran
    - name: urob
      url-base: https://github.com/urob
    - name: ssbb
      url-base: https://github.com/ssbb
    - name: ebottacin
      url-base: https://github.com/ebottacin
  projects:
    - name: zmk-tri-state
      remote: urob
    - name: zmk-auto-layer
      remote: urob
    - name: zmk-listeners
      remote: ssbb
      revision: v1
    - name: zmk-caps-lock-events
      remote: ebottacin
      revision: main
    - name: zmk-info-widget
      remote: ebottacin
      revision: main
    - name: zmk-dynamic-logging
      remote: ebottacin
      repo-path: zmk_dynamic-logging
      revision: main
    - name: zmk-status-selector
      remote: ebottacin
      repo-path: zmk-status-selector
      revision: main
    - name: zmk-deferred-morph
      remote: ebottacin
      revision: main
    - name: zmk
      remote: cormoran
      revision: v0.3-branch+dya
      import: app/west.yml
    - name: zmk-behavior-runtime-sensor-rotate
      remote: cormoran
      revision: main
    - name: zmk-module-ble-management
      remote: cormoran
      revision: zmk-v0.3.0.0
    - name: zmk-module-battery-history
      remote: cormoran
      revision: main
    - name: zmk-module-settings-rpc
      remote: cormoran
      revision: main
    - name: zmk-module-runtime-input-processor
      remote: cormoran
      revision: zmk-v0.3.0.0
  self:
    path: config
```
